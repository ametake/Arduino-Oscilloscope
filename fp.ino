#include "U8glib.h"

U8GLIB_ST7920_128X64_4X u8g(5);	// Hardware SPI configuration. Pin 5 = CS.

// The logo used in welcome screen.
const unsigned char logo[512] U8G_PROGMEM = {
	0x00, 0x00, 0x00, 0x00, 0x00, 0x00, 0x00, 0x00,
	0x00, 0x00, 0x00, 0x00, 0x00, 0x00, 0x00, 0x00,
	0x00, 0x00, 0x00, 0x00, 0x00, 0x00, 0xc0, 0x00,
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	0x00, 0x00, 0x00, 0x00, 0x00, 0x00, 0x00, 0x00,
};

int x, y, sta, i;

//Buffer for buffing sample signal, and Y for the data to display
int Buffer[256];
int Y[128];

int divT = 200; // time delay when sampling
float Vpp;

bool stopMode = false;
bool cursorMode = true;






void setup(void) {

	// flip screen, if required
	// u8g.setRot180();


	pinMode(10, INPUT); // Pin 10 reads if stop mode is on
	pinMode(8, INPUT); // Pin 8 reads if cursor mode is on
	pinMode(6, INPUT); // Pin 6 and 7 is for adjusting divT.
	pinMode(7, INPUT);

	// Turn on the built-in pull-up resistors
	digitalWrite(10, HIGH);
	digitalWrite(8, HIGH);
	digitalWrite(6, HIGH);
	digitalWrite(7, HIGH);


	// Draw a welcome screen.
	u8g.firstPage();
	do {
		welcomeScreen();
	} while ( u8g.nextPage() );

	delay(1000);
}

/***************************/
// this function read the keys.//
void keyScan(void)
{
	// If a key is pressed, delay 20 ms and read again to get rid of any noise, then wait until the button is released.

	if (digitalRead(10) == 0) {
		delay(20);
		if (digitalRead(10) == 0)
			stopMode = !stopMode;
		while (digitalRead(10) == 0);
	}

	if (digitalRead(8) == 0) {
		delay(20);
		if (digitalRead(8) == 0)
			cursorMode = !cursorMode;
		while (digitalRead(8) == 0);
	}


	if (digitalRead(6) == 0) {
		delay(20);
		if (digitalRead(6) == 0)
			divT = min(1000, divT + 10);
		while (digitalRead(6) == 0);
	}

	if (digitalRead(7) == 0) {
		delay(20);
		if (digitalRead(7) == 0)
			divT = max(divT - 10, 0);
		while (digitalRead(7) == 0);
	}

}

/***************************/
// This function samples the
// input signal and process them
// for display.
void sample(void) {

	for (x = 0; x < 192; x++) //sampling input waveform from A0
	{
		delayMicroseconds(divT);
		Buffer[x] = (analogRead(A0));
	}

	int vmax = Buffer[0];
	int vmin = vmax;

	for (i = 0; i < 192; i++)
	{
		if (Buffer[i] > vmax) vmax = Buffer[i];
		if (Buffer[i] < vmin) vmin = Buffer[i];
	}

	int Thr = (vmax + vmin) / 2; //Thresold voltage, this helps to find the rising edge
	Vpp = (vmax - vmin) / 1023.0 * 10; // peak-to-peak voltage

	for (sta = 0; sta < 96; sta++) // this for loop finds the position of the rising edge.
	{
		if (Buffer[sta] < Thr && Buffer[sta + 2] > Thr)
			break;
	}

	for (i = 0; i < 96; i++) //feed the signal to display.
		Y[i] =  map((Buffer[i + sta]), 0, 1023, 0, 64);
}

/*****************/
// This function draw the input signal, the axises and Vpp.
// It should be used inside a picture loop.
void drawWave(void) {
	for (x = 0; x < 96; x++)
		u8g.drawLine(x, Y[x], x, Y[x + 1]); //draw the waveform itself.

	u8g.drawLine(48, 0, 48, 63); // draw axises
	u8g.drawLine(0, 32, 95, 32);
	for (x = 0; x < 96; x += 8)
		u8g.drawLine(x, 31, x, 33);
	for (x = 0; x < 64; x += 8)
		u8g.drawLine(47, x, 49, x);

	u8g.drawFrame(0, 0, 96, 64); //draw the frame

	//print Vpp
	u8g.setPrintPos(98, 6);
	u8g.setFont(u8g_font_04b_03);
	u8g.print("Vpp = ");
	u8g.setPrintPos(98, 14);
	u8g.print(Vpp, 2); u8g.print("V");

	//print dt
	u8g.setPrintPos(98, 20);
	u8g.print("dT = ");
	u8g.setPrintPos(98, 26);
	u8g.print(divT);

	//print stopmode indicator
	if (stopMode) {
		u8g.setPrintPos(98, 53);
		u8g.print("STOP");
	}

}

//this function draw the cursor and the corresponding value.
// It should be used inside a picture loop.
void drawCur(void) {
	// read cursor position from A9 (which is controlled by a potentiometer)
	// also calculate the corresponding value
	int cPos = constrain(map(analogRead(A9), 400, 800, 0, 94), 0, 95);
	float value = 5 - Y[cPos] / 64.0 * 10;

	u8g.drawLine(cPos, 0, cPos, 63); //draw cursor

	u8g.drawLine(max(cPos - 2, 0), max(Y[cPos] - 2, 0), min(cPos + 2, 95), min(Y[cPos] + 2, 64)); //draw a little X mark
	u8g.drawLine(min(cPos + 2, 95), max(Y[cPos] - 2, 0), max(cPos - 2, 0), min(Y[cPos] + 2, 64));

	// show the value of the cursor

	u8g.setFont(u8g_font_04b_03);
	u8g.setPrintPos(98, 32);
	u8g.print("x = ");
	u8g.print(cPos);
	u8g.setPrintPos(98, 39);
	u8g.print("Vx = ");
	u8g.setPrintPos(98, 45);
	u8g.print(value, 2);
	u8g.print("V");
}


void loop(void) {

	keyScan();

	if (!stopMode) {
		sample();
	}
	//picture loop
	u8g.firstPage();
	do
	{
		drawWave();
		if (cursorMode)
			drawCur();
	}
	while ( u8g.nextPage( ));

}

void welcomeScreen(void) {

	u8g.setColorIndex(1); // draw black pixels
	u8g.setFont(u8g_font_04b_03); //set a font
	u8g.setPrintPos(4, 15);
	u8g.print("The ultimate");
	u8g.drawBitmapP( 32, 0, 8, 64, logo); //draw the logo pony
	u8g.setColorIndex(0);
	u8g.setPrintPos(63, 39);
	u8g.print("volt");
	u8g.setColorIndex(1);
	u8g.setPrintPos(81, 39);
	u8g.print("pony");
}

